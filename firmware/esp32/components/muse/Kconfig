## firmware/esp32/components/muse/Kconfig
```kconfig
# Copyright (c) Meta Platforms, Inc. and affiliates.
#
# Licensed under the Apache License, Version 2.0 (the "License");
# you may not use this file except in compliance with the License.
# You may obtain a copy of the License at
#
#     http://www.apache.org/licenses/LICENSE-2.0
#
# Unless required by applicable law or agreed to in writing, software
# distributed under the License is distributed on an "AS IS" BASIS,
# WITHOUT WARRANTIES OR CONDITIONS OF ANY KIND, either express or implied.
# See the License for the specific language governing permissions and
# limitations under the License.

menu "Muse"

    choice MUSE_BOARD
        prompt "Board with the full UI"
        default MUSE_BOARD_NONE
        help
            The UI is the voice companion on boards with a screen: an
            animated avatar, push-to-talk chat, settings, and battery
            handling. It runs beside Home Link, which owns Wi-Fi, BLE
            pairing, credentials and OTA. Pick the board it runs on, or none
            for a Link without a display.

        config MUSE_BOARD_NONE
            bool "None (Home Link without a display)"

        config MUSE_BOARD_WAVESHARE_S3_175C
            bool "Waveshare ESP32-S3-Touch-AMOLED-1.75C"
            depends on IDF_TARGET_ESP32S3

        config MUSE_BOARD_WAVESHARE_S3_175
            bool "Waveshare ESP32-S3-Touch-AMOLED-1.75 (not the 1.75C)"
            depends on IDF_TARGET_ESP32S3

        config MUSE_BOARD_AIPI
            bool "AIPI Lite (ESP32-S3, two buttons, no touch)"
            depends on IDF_TARGET_ESP32S3

        config MUSE_BOARD_ESPRESSIF_BOX_3
            bool "Espressif ESP32-S3-BOX-3 (320x240 touch LCD, speaker and microphones)"
            depends on IDF_TARGET_ESP32S3

        config MUSE_BOARD_WAVESHARE_C6_18
            bool "Waveshare ESP32-C6-Touch-AMOLED-1.8"
            depends on IDF_TARGET_ESP32C6

        config MUSE_BOARD_SENSECAP_WATCHER
            bool "Seeed SenseCAP Watcher (ESP32-S3, round touch LCD, wheel)"
            depends on IDF_TARGET_ESP32S3

        config MUSE_BOARD_M5STACK_CARDPUTER_ADV
            bool "M5Stack Cardputer ADV (ESP32-S3, keyboard, no PSRAM)"
            depends on IDF_TARGET_ESP32S3

        config MUSE_BOARD_M5STACK_STICKS3
            bool "M5Stack StickS3 (ESP32-S3, two buttons, no touch)"
            depends on IDF_TARGET_ESP32S3

        config MUSE_BOARD_M5STACK_STICKC_PLUS2
            bool "M5Stack StickC Plus2 (ESP32, two buttons, no touch)"
            depends on IDF_TARGET_ESP32

        config MUSE_BOARD_M5STACK_STOPWATCH
            bool "M5Stack StopWatch (ESP32-S3, round touch AMOLED)"
            depends on IDF_TARGET_ESP32S3

        config MUSE_BOARD_M5STACK_CORES3
            bool "M5Stack CoreS3 (ESP32-S3, 320x240 touch LCD, speaker and microphones)"
            depends on IDF_TARGET_ESP32S3

        config MUSE_BOARD_M5STACK_STACKCHAN
            bool "M5Stack StackChan K151 (CoreS3 main unit on the StackChan body)"
            depends on IDF_TARGET_ESP32S3

        config MUSE_BOARD_M5STACK_CORE2
            bool "M5Stack Core2 v1.0 (ESP32, touch LCD, touch-strip talk)"
            depends on IDF_TARGET_ESP32
        config MUSE_BOARD_FNK0104B
            bool "Freenove FNK0104B (ESP32-S3, 240x320 touch LCD, ES8311 speaker and mic)"
            depends on IDF_TARGET_ESP32S3
        config MUSE_BOARD_GUITION_JC3248W535
            bool "Guition JC3248W535 (ESP32-S3, 3.5\" 320x480 touch LCD, speaker)"
            depends on IDF_TARGET_ESP32S3
    endchoice

    config MUSE_ENABLED
        bool
        default y if !MUSE_BOARD_NONE

    # Always defined, unlike the target-dependent board options, so
    # idf_component.yml rules can select each board's managed components.
    config MUSE_BOARD_ID
        string
        default "waveshare_s3_175c" if MUSE_BOARD_WAVESHARE_S3_175C
        default "waveshare_s3_175" if MUSE_BOARD_WAVESHARE_S3_175
        default "aipi" if MUSE_BOARD_AIPI
        default "espressif_box_3" if MUSE_BOARD_ESPRESSIF_BOX_3
        default "waveshare_c6_18" if MUSE_BOARD_WAVESHARE_C6_18
        default "sensecap_watcher" if MUSE_BOARD_SENSECAP_WATCHER
        default "m5stack_sticks3" if MUSE_BOARD_M5STACK_STICKS3
        default "m5stack_stickc_plus2" if MUSE_BOARD_M5STACK_STICKC_PLUS2
        default "m5stack_cardputer_adv" if MUSE_BOARD_M5STACK_CARDPUTER_ADV
        default "m5stack_stopwatch" if MUSE_BOARD_M5STACK_STOPWATCH
        default "m5stack_cores3" if MUSE_BOARD_M5STACK_CORES3
        default "m5stack_stackchan" if MUSE_BOARD_M5STACK_STACKCHAN
        default "m5stack_core2" if MUSE_BOARD_M5STACK_CORE2
        default "fnk0104b" if MUSE_BOARD_FNK0104B
        default "guition_jc3248w535" if MUSE_BOARD_GUITION_JC3248W535
        default "none"

    # The Muse tools' serial port: the console UART behind the board's USB
    # bridge, where the chip's own USB Serial/JTAG isn't wired to a connector
    # (the Watcher's USB-C goes to a CH342) or the chip has none.
    config MUSE_CONSOLE_UART
        bool
        default y if MUSE_BOARD_SENSECAP_WATCHER || !SOC_USB_SERIAL_JTAG_SUPPORTED

    # A board overlay can raise this for a quiet speaker.
    config MUSE_DEFAULT_VOLUME
        int "Speaker volume until one is chosen in settings (percent)"
        range 0 100
        default 70

    config MUSE_WATCHER_CAMERA
        bool "SenseCAP Watcher camera capture and live preview"
        depends on MUSE_BOARD_SENSECAP_WATCHER && SPIRAM
        default n
        help
            Enable the camera.capture Home Link command and the wheel
            double-click camera preview. Camera buffers and tasks consume
            memory and preview decoding shares CPU time with voice and Link.
            Leave disabled to build without camera support.

    config MUSE_STACKCHAN_YAW_ZERO
        int "StackChan K151: yaw servo raw position facing forward"
        depends on MUSE_BOARD_M5STACK_STACKCHAN
        range 0 1000
        default 460
        help
            Raw SCSCL position (0.3125 degrees a step) of the horizontal
            servo when the head faces forward. M5Stack's default is 460; each
            unit's factory calibration is in its factory NVS (servo/zero_pos_1).

    config MUSE_STACKCHAN_PITCH_ZERO
        int "StackChan K151: pitch servo raw position when level"
        depends on MUSE_BOARD_M5STACK_STACKCHAN
        range 0 1000
        default 620
        help
            Raw position of the vertical servo at its zero (M5Stack default
            620; factory NVS servo/zero_pos_2).

    config MUSE_STACKCHAN_PET_NOD
        bool "StackChan K151: nod after a stroke on the head"
        depends on MUSE_BOARD_M5STACK_STACKCHAN
        default y
        help
            After a stroke on the head, once the hand has left (0.4 s) and
            while Muse is idle, nod gently. Never while a hand is on the head;
            at most once every 5 s.

    config MUSE_STACKCHAN_CAMERA_HFLIP
        bool "StackChan K151: mirror the camera image horizontally"
        depends on MUSE_BOARD_M5STACK_STACKCHAN
        default n
        help
            Off: the GC0308's default orientation is correct on the K151
            (checked with a raised left hand: it appears on the image's right,
            as in a normal photo). An earlier "mirrored text" report came from
            how the page was held. '>camera.hflip=0|1' switches it at run time.

    config MUSE_STACKCHAN_DOA
        bool "StackChan K151: turn to a near talker (experimental)"
        depends on MUSE_BOARD_M5STACK_STACKCHAN && MUSE_HANDS_FREE
        default n
        help
            In hands-free conversations, estimates from the two mics (3 cm
            apart) which side a talker is on and turns the head about 20
            degrees towards them while Muse thinks, back after the
            conversation. Reliable only close up: at about 1 m the sides
            overlap (see TEST_REPORT.md), so it turns only with a clear
            margin. A settings switch, off until the user turns it on.

    config MUSE_STACKCHAN_DOA_CENTER_X100
        int "StackChan K151: direction delay that means straight ahead (1/100 sample)"
        depends on MUSE_STACKCHAN_DOA
        default -3

    config MUSE_STACKCHAN_DOA_THRESH_X100
        int "StackChan K151: margin from straight ahead to turn (1/100 sample)"
        depends on MUSE_STACKCHAN_DOA
        default 10

    config MUSE_TTS_MINIMAX
        bool "Speak replies with MiniMax"
        depends on MUSE_HATCH
        default n
        help
            Sends each reply's text to MiniMax's T2A v2 API
            (api.minimaxi.com, a paid service billed to the key's account)
            and plays the MP3 it returns, captions following, while the
            speaker is on. Does nothing until an API key is set. Without
            speech, or if MiniMax fails, replies show at reading pace.

    config MUSE_TTS_MINIMAX_KEY
        string "MiniMax API key"
        depends on MUSE_TTS_MINIMAX
        default ""
        help
            Your key from platform.minimaxi.com. Like the SDK token it ends up
            in the build's sdkconfig, which isn't committed, and in the
            firmware image: development only. A product would call MiniMax
            through its own proxy instead of carrying the key.

    config MUSE_TTS_MINIMAX_VOICE
        string "MiniMax voice"
        depends on MUSE_TTS_MINIMAX
        default "Chinese (Mandarin)_Straightforward_Boy"
        help
            A voice_id from MiniMax's voice list.

    config MUSE_TTS_MINIMAX_MODEL
        string "MiniMax model"
        depends on MUSE_TTS_MINIMAX
        default "speech-02-turbo"

    config MUSE_HANDS_FREE
        bool "Hands-free conversation (a setting, off by default)"
        depends on MUSE_ENABLED
        default n
        help
            Adds a "Hands-free talk" setting. With it on, a press of the talk
            button (or a tap on the character, a touch on the head where the
            board posts one) starts a conversation: each turn ends when you
            stop talking (on-device detection, muse_vad.c), and after Muse
            answers it listens for a follow-up for a few seconds. Nothing is
            listened for or sent outside a conversation the user started.

    config MUSE_AVATAR_GESTURES
        bool "Double tap, long-press talk and reactions on the character"
        depends on MUSE_ENABLED
        default n
        help
            On touch boards: a tap makes Muse hop, a double tap surprises it
            and a long press records while held (only once Muse is online;
            pairing is still confirmed with the talk button). Boards can also
            make it shy (muse_state_react). Reactions show only while idle.

    config MUSE_CJK_FONT
        bool "Show Chinese and Japanese in captions"
        depends on MUSE_ENABLED
        default n
        help
            Captions fall back to GNU Unifont's 16x16 bitmaps for CJK
            punctuation, kana, the CJK Unified Ideographs and fullwidth
            forms that the ASCII caption font lacks. Small screens, whose
            captions are two lines of 8 px text, show a reply with CJK in it
            one 16 px line at a time. Takes about 850 KB of flash and no RAM.
            Without it those characters show as boxes. Hangul isn't
            included.

    config MUSE_JC3248W535_MIC_GPIO
        int "JC3248W535: GPIO for an external I2S mic's data (SD) line"
        depends on MUSE_BOARD_GUITION_JC3248W535
        range -1 48
        default -1
        help
            The board has a speaker amp but no microphone. Wire an I2S MEMS
            mic such as an INMP441 to the speaker's clocks (SCK to GPIO42, WS
            to GPIO2), L/R to GND, power to 3.3 V, and its SD line to a free
            GPIO, and set that GPIO here. -1 leaves push-to-talk recording
            silence.

    config MUSE_HATCH
        bool "Muse's own voice session"
        depends on MUSE_ENABLED
        default y if SPIRAM
        default n
        help
            Push-to-talk turns go over a voice session of Muse's own, to the
            VM Home Link is paired with or one set up on the device with a
            device token. Replies are text, shown as captions; start_tts in
            muse_chat_session.cpp is where a TTS API of your own can speak
            them. Needs PSRAM. Without it, voice notes go over Home Link's own
            session to its paired VM and replies are shown as text.

endmenu
```
